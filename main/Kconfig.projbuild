## main/Kconfig.projbuild
```kconfig
menu "App setup"

    choice COMM_PROTOCOL
        prompt "Communication protocol"
        default COMM_PROTOCOL_I2C
        help
            Choose the communication protocol implementation

        config COMM_PROTOCOL_I2C
            bool "I2C"
        config COMM_PROTOCOL_SPI
            bool "SPI"
    endchoice

    if COMM_PROTOCOL_I2C

        menu "I2C setup"
    
        config I2C_SDA_GPIO
            int "I2C SDA GPIO"
            default 21
            help
                I2C SDA GPIO.

        config I2C_SCL_GPIO
            int "I2C SCL GPIO"
            default 22
            help
                I2C SCL GPIO.

        config I2C_SLAVE_ADDRESS
            hex "I2C slave address"
            default 0x08
            help
                I2C slave address.

        endmenu

    endif

    if COMM_PROTOCOL_SPI

        menu "SPI setup"

        config SPI_MISO_GPIO
            int "SPI MISO GPIO"
            default 12
            help
                SPI MISO GPIO.

        config SPI_MOSI_GPIO
            int "SPI MOSI GPIO"
            default 13
            help
                SPI MOSI GPIO.

        config SPI_SCLK_GPIO
            int "SPI SCLK GPIO"
            default 14
            help
                SPI SCLK GPIO.

        config SPI_CS_GPIO
            int "SPI CS GPIO"
            default 15
            help
                SPI CS GPIO.

        endmenu

    endif

    config GPIO_INTERRUPT_OUT
        int "GPIO interrupt out"
        default 18
        help
            GPIO interrupt out.

endmenu
```

## sdkconfig.defaults.esp32
```kconfig
CONFIG_I2C_SDA_GPIO=21
CONFIG_I2C_SCL_GPIO=22
CONFIG_I2C_SLAVE_ADDRESS=0x08
CONFIG_SPI_MISO_GPIO=12
CONFIG_SPI_MOSI_GPIO=13
CONFIG_SPI_SCLK_GPIO=14
CONFIG_SPI_CS_GPIO=15
CONFIG_GPIO_INTERRUPT_OUT=18
```
